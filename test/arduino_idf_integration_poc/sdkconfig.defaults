## test/arduino_idf_integration_poc/sdkconfig.defaults
```kconfig
CONFIG_IDF_TARGET="esp32s3"
CONFIG_FREERTOS_HZ=1000
CONFIG_AUTOSTART_ARDUINO=n

# mbedTLS PSK support for Arduino NetworkClientSecure
CONFIG_MBEDTLS_PSK_MODES=y
CONFIG_MBEDTLS_KEY_EXCHANGE_PSK=y
CONFIG_MBEDTLS_KEY_EXCHANGE_DHE_PSK=y
CONFIG_MBEDTLS_KEY_EXCHANGE_ECDHE_PSK=y
CONFIG_MBEDTLS_KEY_EXCHANGE_RSA_PSK=y

# TinyUSB and UAC Driver Configuration
CONFIG_UAC_SPEAKER_CHANNEL_NUM=2
CONFIG_UAC_MIC_CHANNEL_NUM=0
CONFIG_UAC_SAMPLE_RATE=48000

# TFT_eSPI Parallel 8-bit ST7789 Configuration
CONFIG_TFT_ST7789_DRIVER=y
# CONFIG_TFT_ILI9341_DRIVER is not set
CONFIG_TFT_RGB_ORDER=y
CONFIG_TFT_INVERSION_ON=y
# CONFIG_TFT_INVERSION_DISABLE is not set
CONFIG_TFT_PARALLEL_8_BIT=y
# CONFIG_TFT_SPI is not set
CONFIG_TFT_WIDTH=170
CONFIG_TFT_HEIGHT=320
CONFIG_TFT_CS=6
CONFIG_TFT_DC=7
CONFIG_TFT_RST=5
CONFIG_TFT_WR=8
CONFIG_TFT_RD=9
CONFIG_TFT_D0=39
CONFIG_TFT_D1=40
CONFIG_TFT_D2=41
CONFIG_TFT_D3=42
CONFIG_TFT_D4=45
CONFIG_TFT_D5=46
CONFIG_TFT_D6=47
CONFIG_TFT_D7=48
CONFIG_ENABLE_BL=y
CONFIG_TFT_BL=38
CONFIG_TFT_BACKLIGHT_ON_HIGH=y
CONFIG_TFT_BACKLIGHT_ON=1
CONFIG_LOAD_GLCD=y
CONFIG_LOAD_FONT2=y
CONFIG_LOAD_FONT4=y
CONFIG_LOAD_FONT6=y
CONFIG_LOAD_FONT7=y
CONFIG_LOAD_FONT8=y
CONFIG_LOAD_GFXFF=y
CONFIG_SMOOTH_FONT=y

# Flash Memory Size Configuration (16MB required for dual 0x640000 app0/app1 slots + SPIFFS + Coredump)
CONFIG_ESPTOOLPY_FLASHSIZE_16MB=y
CONFIG_ESPTOOLPY_FLASHSIZE="16MB"

# Bootloader App Rollback Support
CONFIG_BOOTLOADER_APP_ROLLBACK_ENABLE=y

# PSRAM / Octal SPIRAM Configuration (8MB OPI PSRAM on LilyGo T-Display-S3)
CONFIG_SPIRAM=y
CONFIG_SPIRAM_MODE_OCT=y
CONFIG_SPIRAM_TYPE_AUTO=y
```
